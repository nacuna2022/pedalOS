## Kconfig
```kconfig
mainmenu "Musictribe RTOS"

menu "Build Setup"

config IMAGE_NAME
        string "Output image filename"
        default "pedalOS"

menu "Binary output formats" 
config RAW_BINARY
        bool 'Raw binary'
        default y
config INTEL_HEX
        bool "Intel Hex"
        default y
config MUSICTRIBE_SYX
        bool "MusicTribe Syx"
        default y
        depends on INTEL_HEX
endmenu # Binary output formats

choice 
        prompt "Optimization level"
config OPTIMIZATION_NONE
        bool "No optimization"
config OPTIMIZATION_NORMAL
        bool "Normal optimization"
config OPTIMIZATION_AGGRESSIVE
        bool "Aggressive optimization"
endchoice # Optimization level

config GENERATE_LINK_MAP
        bool "Generate link map"

config GENERATE_SYMBOL_FILE
        bool "Generate symbol file"

endmenu # Build Setup

menu "System Type"
source board/Kconfig
endmenu
```

## arm/Kconfig
```kconfig
# - ARM ARCHITECTURE ----------------------------------------------------------
config ARMV6M
        bool
        default n

config ARMV7M
        bool
        default n

config ARMV8M
        bool
        default n

config ARM_ARCH
        string
        default "armv6"         if ARMV6
        default "armv7-m"       if ARMV7M
        default "armv8-m"       if ARMV8M


# - ARM CORE ------------------------------------------------------------------
config CORTEXM3
        bool
        select ARMV7M
        select THUMB_MODE

config CORTEXM4
        bool
        select ARMV7M
        select THUMB_MODE
        select HAVE_FPU

config CORTEXM7
        bool
        select ARMV7M
        select THUMB_MODE
        select HAVE_FPU

config ARM_CORE
        string
        default "cortex-m3"     if CORTEXM3
        default "cortex-m4"     if CORTEXM4
        default "cortex-m7"     if CORTEXM7


comment "ARM Options"

config TOOLCHAIN_PREFIX
        string "toolchain prefix"
        default "arm-none-eabi"

config THUMB_MODE
        bool "Thumb mode"
        default n

config SOFT_FLOATS
        bool "Use softFPU"
        default n

config HAVE_FPU
        bool "fpu support"
        default n

if ARMV7M
source arm/armv7-m/Kconfig
endif
```

## arm/armv7-m/Kconfig
```kconfig
if ARMV7M
comment "ARMv7-M Options"

config ARMV7M_OPTION1
        bool "placeholder for ARMv7-M options"


endif # ARMV7M
```

## board/Kconfig
```kconfig
#nacuna ??? BOARD SELECTS THE MCU
choice 
        prompt "Select musictribe board"
config SHOPEE_BOARD
        bool "GD32F407VET6 board from shopee.ph"
endchoice # music tribe boards

config BOARD_NAME
        string
        default "bm11m"         if BM11M
        default "bm15m"         if BM15M
        default "bm18m"         if BM18M
        default "rl06"          if RL06
        default "shopee_board"  if SHOPEE_BOARD

source mcu/Kconfig
source arm/Kconfig

if SHOPEE_BOARD
source board/shopee_board/Kconfig
endif
```

## mcu/Kconfig
```kconfig
#nacuna ??? MCU SELECTS THE ARM CORE (READ!!! not the ARM ARCHITECTURE)
choice 
        prompt "MCU Selection"
        default STM32H7         if RL06
        default GD32F4          if BM11M || BM15M || BM18M || GD32F425_DEMO

config STM32H7
        bool "STM32H7"
        select CORTEXM7
config GD32F4
        bool "GD32F4"
        select CORTEXM4
endchoice # MCU Selection

config MCU_INTERRUPT_COUNT
        int "MCU Interrupt Count"
        default 150     if STM32H7
        default 91      if GD32F4

config MCU
        string
        default "stm32h7"       if STM32H7
        default "gd32f4"        if GD32F4

if STM32H7
source mcu/stm32h7/Kconfig
endif

if GD32F4
source mcu/gd32f4/Kconfig
endif
```

## mcu/gd32f4/Kconfig
```kconfig
comment "GD32F4 Options"

choice 
        prompt "Select GD32F4 Chip"

config GD32F450
        bool "GD32F450"
config GD32F405
        bool "GD32F405"
config GD32F407
        bool "GD32F407"
config GD32F470
        bool "GD32F470"
config GD32F425
        bool "GD32F425"
config GD32F427
        bool "GD32F427"
endchoice

config GD32F4_CHIP
        string
        default "GD32F450"      if GD32F450
        default "GD32F405"      if GD32F405
        default "GD32F407"      if GD32F407
        default "GD32F470"      if GD32F470
        default "GD32F425"      if GD32F425
        default "GD32F427"      if GD32F427


menu "GD32F4 Peripherals"

config GD32F4_ADC
        bool "ADC"
        default n
config GD32F4_CAN
        bool "CAN"
        default n
config GD32F4_CRC
        bool "CRC"
        default n
config GD32F4_CTC
        bool "CTC"
        default n
config GD32F4_DAC
        bool "DAC"
        default n
config GD32F4_DBG
        bool "DBG"
        default n
config GD32F4_DCI
        bool "DCI"
        default n
config GD32F4_DMA
        bool "DMA"
        default n
config GD32F4_ENET
        bool "Enet"
        default n
config GD32F4_EXMC
        bool "Exti"
config GD32F4_EXTI
        bool "Exmc"
        default n
config GD32F4_FMC
        bool "FMC"
        default n
config GD32F4_FWDGT
        bool "FWDGT"
        default n
config GD32F4_GPIO
        bool "GPIO"
        default n
config GD32F4_I2C
        bool "I2C"
        default n
config GD32F4_IPA
        bool "IPA"
        default n
config GD32F4_IREF
        bool "Iref"
        default n
config GD32F4_MISC
        bool "Misc"
        default n
config GD32F4_PMU
        bool "PMU"
        default n
config GD32F4_RCU
        bool "RCU"
        default n
config GD32F4_RTC
        bool "RTC"
        default n
config GD32F4_SDIO
        bool "SDIO"
        default n
config GD32F4_SPI
        bool "SPI"
        default n
config GD32F4_SYSCFG
        bool "SysCfg"
        default n
config GD32F4_TIMER
        bool "Timer"
        default n
config GD32F4_TLI
        bool "TLI"
        default n
config GD32F4_TRNG
        bool "TRNG"
        default n
config GD32F4_USART
        bool "USART"
        default n
config GD32F4_WWDGT
        bool "WWDGT"
        default n
endmenu


config HXTAL_VALUE
        int "High speed crystal oscillator (HXTAL) value in Hz"     
        default 25000000

config HXTAL_STARTUP_TIMEOUT
        hex "High speed crystal oscillator timeout"
        default 0xFFFF

config IRC16M_VALUE
        int "Internal 16Mhz oscillator (IRC16M) in Hz"
        default 16000000

config IRC16M_STARTUP_TIMEOUT
        hex "High speed crystal oscillator timeout"
        default 0x0500

config IRC32K_VALUE
        int "Internal 32Khz RC oscillator(IRC32K) in Hz"
        default 32000

config LXTAL_VALUE
        int "Low speed crystal oscillator (LXTAL)in Hz"
        default 32768
```

## mcu/stm32h7/Kconfig
```kconfig
comment "STM32H7 Options"

config STM32H7_HAL
        bool
        default y
        select STM32H7_CORTEX
        select STM32H7_RCC

menu "STM32H7 Peripherals"
config STM32H7_ADC
        bool "ADC"
        default n
        select STM32H7_DMA
config STM32H7_CEC
        bool "CEC"
        default n
config STM32H7_COMP
        bool "Comp"
        default n
config STM32H7_CORDIC
        bool "Cordic"
        default n
config STM32H7_CORTEX
        bool "Cortex"
        default n
config STM32H7_CRC
        bool "CRC"
        default n
config STM32H7_CRYP
        bool "Cryp"
        default n
        select STM32H7_DMA
config STM32H7_DAC
        bool "DAC"
        default n
        select STM32H7_DMA
config STM32H7_DCMI
        bool "DCMI"
        default n
        select STM32H7_DMA
config STM32H7_DMA2D
        bool "DMA2D"
        default n
config STM32H7_DFSDM
        bool "DFSDM"
        default n
        select STM32H7_DMA
config STM32H7_DMA
        bool "DMA"
        default n
config STM32H7_DSI
        bool "DSI"
        default n
config STM32H7_DTS
        bool "DTS"
        default n
config STM32H7_ETH
        bool "Eth"
        default n
config STM32H7_EXTI
        bool "Exti"
        default n
config STM32H7_FDCAN
        bool "FDCAN"
        default n
config STM32H7_FLASH
        bool "Flash"
        default n
config STM32H7_FMAC
        bool "FMAC"
        default n
config STM32H7_GFXMMU
        bool "GFX MMU"
        default n
config STM32H7_GPIO
        bool "GPIO"
        default n
config STM32H7_HASH
        bool "Hash"
        default n
        select STM32H7_DMA
config STM32H7_HCD
        bool "HCD"
        default n
config STM32H7_HRTIM
        bool "Hrtim"
        default n
        select STM32H7_DMA
config STM32H7_HSEM
        bool "Hsem"
        default n
config STM32H7_I2C
        bool "I2C"
        default n
        select STM32H7_DMA
config STM32H7_I2S
        bool "I2S"
        default n
        select STM32H7_DMA
config STM32H7_IRDA
        bool "IRDA"
        default n
        select STM32H7_DMA
config STM32H7_IWDG
        bool "IWDG"
        default n
config STM32H7_JPEG
        bool "Jpeg"
        default n
        select STM32H7_MDMA
config STM32H7_LPTIM
        bool "LPTIM"
        default n
config STM32H7_LTDC
        bool "LTDC"
        default n
config STM32H7_MDIOS
        bool "MDIOS"
        default n
config STM32H7_MDMA
        bool "MDMA"
        default n
config STM32H7_MMC
        bool "MMC"
        default n
        select STM32H7_DMA
config STM32H7_NAND
        bool "Nand"
        default n
config STM32H7_NOR
        bool "Nor"
        default n
config STM32H7_OPAMP
        bool "Opamp"
        default n
config STM32H7_OSPI
        bool "OSPI"
        default n
config STM32H7_OTFDEC
        bool "OTFDEC"
        default n
config STM32H7_PCD
        bool "PCD"
        default n
config STM32H7_PSSI
        bool "PSSI"
        default n
config STM32H7_PWR
        bool "PWR"
        default n
config STM32H7_QSPI
        bool "QSPI"
        default n
        select STM32H7_MDMA
config STM32H7_RAMECC
        bool "RAM ECC"
        default n
config STM32H7_RCC
        bool "RCC"
        default n
        select STM32H7_GPIO
        select STM32H7_FLASH
config STM32H7_RNG
        bool "RNG"
        default n
config STM32H7_RTC
        bool "RTC"
        default n
config STM32H7_SAI
        bool "SAI"
        default n
        select STM32H7_DMA
config STM32H7_SD
        bool "SD"
        default n
config STM32H7_SDRAM
        bool "SDRAM"
        default n
        select STM32H7_MDMA
config STM32H7_SMARTCARD
        bool "Smartcard"
        default n
        select STM32H7_DMA
config STM32H7_SMBUS
        bool "SMBUS"
        default n
config STM32H7_SPDIFRX
        bool "SPDIFRX"
        default n
        select STM32H7_DMA
config STM32H7_SPI
        bool "SPI"
        default n
        select STM32H7_DMA
config STM32H7_SRAM
        bool "SRAM"
        default n
        select STM32H7_MDMA
config STM32H7_SWPMI
        bool "SWPMI"
        default n
        select STM32H7_DMA
config STM32H7_TIM
        bool "TIM"
        default n
        select STM32H7_DMA
config STM32H7_UART
        bool "UART"
        default n
        select STM32H7_DMA
config STM32H7_USART
        bool "USART"
        default n
        select STM32H7_DMA
config STM32H7_WWDG
        bool "WWDG"
        default n
endmenu
```
